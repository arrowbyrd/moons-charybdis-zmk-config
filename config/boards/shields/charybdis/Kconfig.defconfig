## config/boards/shields/charybdis/Kconfig.defconfig
```kconfig
if SHIELD_CHARYBDIS_RIGHT

config ZMK_KEYBOARD_NAME
	default "Charybdis"

config ZMK_SPLIT_BLE_ROLE_CENTRAL
	default y

config ZMK_RGB_UNDERGLOW
    bool "Enable RGB Underglow"
    default y

config ZMK_RGB_UNDERGLOW_BRT_START
    int "Starting Brightness (0-100)"
    default 30

config ZMK_RGB_UNDERGLOW_HUE_START
    int "Starting Hue (0-360)"
    default 75

config ZMK_RGB_UNDERGLOW_SAT_START
    int "Starting Saturation (0-100)"
    default 100

endif

if SHIELD_CHARYBDIS_LEFT || SHIELD_CHARYBDIS_RIGHT

config ZMK_SPLIT
	default y
	
endif
```

## config/boards/shields/charybdis/Kconfig.shield
```kconfig
config SHIELD_CHARYBDIS_LEFT
	def_bool $(shields_list_contains,charybdis_left)

config SHIELD_CHARYBDIS_RIGHT
	def_bool $(shields_list_contains,charybdis_right)

config ZMK_BACKLIGHT
	bool y

config ZMK_BACKLIGHT_BRT_START
    int 50

config ZMK_BACKLIGHT_AUTO_OFF_IDLE
    bool "Turn off backlight when keyboard goes into idle state"

config ZMK_BACKLIGHT_ON_START
    bool "Default backlight state"
```
